// This program is partially copied from https://www.creativity-ape.com/entry/2020/12/16/232928

#include <avr/pgmspace.h> 

const int N_Positive_Pins = 4;
const int Positive_Pins[] = { 3, 6, 10, 13 };
const int N_Negative_Pins = 3;
const int Negative_Pins[] = { 5, 9, 11 };

const int N_SWs = 7;
const int SWs[] = { A0, A1, A2, A3, A4, A5, 4, 8 };

PROGMEM const unsigned char FastGamma8[] = { // not used
  0, 0, 0, 0, 0, 0, 0, 0, 0, 0, 0, 0, 0, 0, 0, 0, 
  1, 1, 1, 1, 1, 1, 1, 2, 2, 2, 2, 2, 3, 3, 3, 3, 
  4, 4, 4, 4, 5, 5, 5, 5, 6, 6, 6, 7, 7, 7, 8, 8, 
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  225, 226, 228, 230, 232, 234, 236, 238, 240, 242, 244, 246, 248, 250, 252, 254,
};

PROGMEM const unsigned char FasterGamma8[] = {
  0, 0, 0, 0, 0, 0, 0, 0, 0, 0, 0, 0, 0, 0, 0, 0, 
  0, 0, 0, 0, 0, 0, 0, 0, 0, 0, 0, 0, 0, 0, 0, 0, 
  0, 0, 0, 0, 0, 0, 0, 0, 0, 1, 1, 1, 1, 1, 1, 1, 
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  210, 213, 216, 218, 221, 224, 227, 229, 232, 235, 238, 241, 244, 247, 250, 253, 
};

PROGMEM const unsigned char Gamma8[] = { // not used
  0, 0, 0, 0, 0, 0, 0, 0, 0, 0, 0, 0, 0, 0, 0, 0,
  0, 0, 0, 0, 0, 0, 0, 0, 0, 0, 0, 0, 1, 1, 1, 1,
  1, 1, 1, 1, 1, 1, 1, 1, 1, 2, 2, 2, 2, 2, 2, 2,
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  215, 218, 220, 223, 225, 228, 231, 233, 236, 239, 241, 244, 247, 249, 252, 255
};

PROGMEM const unsigned char Linear8[] = { // not used
  0, 1, 2, 3, 4, 5, 6, 7, 8, 9, 10, 11, 12, 13, 14, 15,
  16, 17, 18, 19, 20, 21, 22, 23, 24, 25, 26, 27, 28, 29, 30, 31,
  32, 33, 34, 35, 36, 37, 38, 39, 40, 41, 42, 43, 44, 45, 46, 47, 
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  240, 241, 242, 243, 244, 245, 246, 247, 248, 249, 250, 251, 252, 253, 254, 255,
};

float value = 0.1;

const int Max_Value = 255;
const int Dimming_Range = 90; // magic number
const float Threshold = 0.065; // magic number

int randSeed = 0;

void setup() {
  Serial.begin(9600);
  for (int n = 0; n < N_Positive_Pins; ++n) {
    pinMode(Positive_Pins[n], OUTPUT);
  }
  for (int n = 0; n < N_Negative_Pins; ++n) {
    pinMode(Negative_Pins[n], OUTPUT);
  }
  for (int n = 0; n < N_SWs; ++n) {
    pinMode(SWs[n], INPUT_PULLUP);
  }
  for (int n = 0; n < N_SWs; ++n) {
    int s = digitalRead(SWs[n]);
    randSeed |= ((s & 0x01) << n);
  }
  Serial.print("randSeed = ");
  Serial.println(randSeed);
  randomSeed(randSeed);
}

void loop() {
  if (value < 0.5) {
    value = value + 2.0 * value * value;
  }
  else if (value >= 0.5) {
    value = value - 2.0 * (1.0 - value) * (1.0 - value);
  }

  if (value <= (0.0 + Threshold) || (1.0 - Threshold) <= value) {
    value = random(0.0 + (Threshold * 1000.0), 1000.0 - (Threshold * 1000.0)) / 1000.0;
  }

  int value_p = Max_Value - Dimming_Range + (value * Dimming_Range);
  int value_n = Max_Value - (value * Dimming_Range);

  for (int n = 0; n < N_Positive_Pins; ++n) {
    analogWrite(Positive_Pins[n], pgm_read_byte(&(FasterGamma8[value_p])));
  }
  for (int n = 0; n < N_Negative_Pins; ++n) {
    analogWrite(Negative_Pins[n], pgm_read_byte(&(FasterGamma8[value_n])));
  }
  
  delay(70);
}
